## config/west.yml
```yaml
manifest:
  remotes:
    - name: zmkfirmware
      url-base: https://github.com/zmkfirmware
    - name: m165437 #new entry
      url-base: https://github.com/M165437 #new entry
  projects:
    - name: zmk
      remote: zmkfirmware
      revision: a23aa009d7a07d67fe5609caca7372e16610f238
      import: app/west.yml
    - name: nice-view-gem #new entry
      remote: m165437 #new entry
      revision: 0a50fe209d929c916c5664c6affd0f4977c6b012 #new entry
  self:
    path: config
```
